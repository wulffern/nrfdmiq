## CMakeLists.txt
```
######################################################################
##        Copyright (c) 2022 Carsten Wulff Software, Norway
## ###################################################################
## Created       : wulff at 2022-5-28
## ###################################################################
##  The MIT License (MIT)
##
##  Permission is hereby granted, free of charge, to any person obtaining a copy
##  of this software and associated documentation files (the "Software"), to deal
##  in the Software without restriction, including without limitation the rights
##  to use, copy, modify, merge, publish, distribute, sublicense, and/or sell
##  copies of the Software, and to permit persons to whom the Software is
##  furnished to do so, subject to the following conditions:
##
##  The above copyright notice and this permission notice shall be included in all
##  copies or substantial portions of the Software.
##
##  THE SOFTWARE IS PROVIDED "AS IS", WITHOUT WARRANTY OF ANY KIND, EXPRESS OR
##  IMPLIED, INCLUDING BUT NOT LIMITED TO THE WARRANTIES OF MERCHANTABILITY,
##  FITNESS FOR A PARTICULAR PURPOSE AND NONINFRINGEMENT. IN NO EVENT SHALL THE
##  AUTHORS OR COPYRIGHT HOLDERS BE LIABLE FOR ANY CLAIM, DAMAGES OR OTHER
##  LIABILITY, WHETHER IN AN ACTION OF CONTRACT, TORT OR OTHERWISE, ARISING FROM,
##  OUT OF OR IN CONNECTION WITH THE SOFTWARE OR THE USE OR OTHER DEALINGS IN THE
##  SOFTWARE.
##
######################################################################


cmake_minimum_required(VERSION 3.20.0)

find_package(Zephyr REQUIRED HINTS $ENV{ZEPHYR_BASE})
project(reflector)

if(NOT DEFINED DM_REFLECTOR_TIMEOUT_US)
  set(DM_REFLECTOR_TIMEOUT_US 500000)
endif()
if(NOT DEFINED DM_INITIATOR_TIMEOUT_US)
  set(DM_INITIATOR_TIMEOUT_US 50000)
endif()

zephyr_include_directories(${CMAKE_CURRENT_SOURCE_DIR}/../common/include)
target_compile_definitions(app PRIVATE
  DM_REFLECTOR_TIMEOUT_US=${DM_REFLECTOR_TIMEOUT_US}
  DM_INITIATOR_TIMEOUT_US=${DM_INITIATOR_TIMEOUT_US}
)
target_sources(app PRIVATE  src/main.c)
```

## prj.conf
```kconfig
CONFIG_SERIAL=y

CONFIG_GPIO=y

CONFIG_NRF_DM=y
CONFIG_NEWLIB_LIBC=y
```

## src/main.c
```c
/*********************************************************************
 *        Copyright (c) 2022 Carsten Wulff Software, Norway
 * *******************************************************************
 * Created       : wulff at 2022-5-28
 * *******************************************************************
 *  The MIT License (MIT)
 *
 *  Permission is hereby granted, free of charge, to any person obtaining a copy
 *  of this software and associated documentation files (the "Software"), to deal
 *  in the Software without restriction, including without limitation the rights
 *  to use, copy, modify, merge, publish, distribute, sublicense, and/or sell
 *  copies of the Software, and to permit persons to whom the Software is
 *  furnished to do so, subject to the following conditions:
 *
 *  The above copyright notice and this permission notice shall be included in all
 *  copies or substantial portions of the Software.
 *
 *  THE SOFTWARE IS PROVIDED "AS IS", WITHOUT WARRANTY OF ANY KIND, EXPRESS OR
 *  IMPLIED, INCLUDING BUT NOT LIMITED TO THE WARRANTIES OF MERCHANTABILITY,
 *  FITNESS FOR A PARTICULAR PURPOSE AND NONINFRINGEMENT. IN NO EVENT SHALL THE
 *  AUTHORS OR COPYRIGHT HOLDERS BE LIABLE FOR ANY CLAIM, DAMAGES OR OTHER
 *  LIABILITY, WHETHER IN AN ACTION OF CONTRACT, TORT OR OTHERWISE, ARISING FROM,
 *  OUT OF OR IN CONNECTION WITH THE SOFTWARE OR THE USE OR OTHER DEALINGS IN THE
 *  SOFTWARE.
 *
 ********************************************************************/


//#include <zephyr.h>
//#include <init.h>
#include <mdk/nrf.h>
#include <nrfx.h>
#include "nrf_dm.h"
#include <nrfx_config.h>
#include <nrfx_clock.h>

#include "dm.c"
#include "dm_timeout.h"

static nrf_dm_config_t dm_config;

int main(void)
{

  dm_clock_init();

  debug_init();

  dm_init();

  dm_config = NRF_DM_DEFAULT_CONFIG;
  dm_config.role            = NRF_DM_ROLE_REFLECTOR;
  dm_config.rng_seed        = 0x44ddaafa;

  while (1)
  {

    nrf_dm_status_t status  = nrf_dm_configure(&dm_config);
    debug_start();
    uint32_t timeout_us = DM_REFLECTOR_TIMEOUT_US;
    status     = nrf_dm_proc_execute(timeout_us);
    debug_stop();

    if(status == NRF_DM_STATUS_SUCCESS){
      debug_pulse(10);
    }else{
      debug_pulse(5);

    }

  }
}
```

## src/dm.c
```c
../../common/src/dm.c
```
